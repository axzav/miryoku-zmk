// Copyright 2021 Manna Harbour
// https://github.com/manna-harbour/miryoku

#define MIRYOKU_MAPPING( \
KX0, KX1, K00, K01, K02, K03, K04,      K05, K06, K07, K08, K09, KX2, KX3, \
     KX4, K10, K11, K12, K13, K14,      K15, K16, K17, K18, K19, KX5, \
     KX6, K20, K21, K22, K23, K24,      K25, K26, K27, K28, K29, KX7, \
          N30, N31, K32, K33, K34,      K35, K36, K37, N38, N39 \
) \
KX0  KX1  K00  K01  K02  K03  K04       K05  K06  K07  K08  K09  KX2  KX3 \
     KX4  K10  K11  K12  K13  K14       K15  K16  K17  K18  K19  KX5 \
     KX6  K20  K21  K22  K23  K24       K25  K26  K27  K28  K29  KX7 \
                    K32  K33  K34       K35  K36  K37


#include "../miryoku/miryoku.dtsi"
